## src/mainboard/hewlett_packard/Kconfig
```kconfig
## SPDX-License-Identifier: GPL-2.0-only

if VENDOR_HEWLETT_PACKARD

source "src/mainboard/hewlett_packard/probook_4530s/Kconfig"

endif
```

## src/mainboard/hewlett_packard/Kconfig.name
```kconfig
## SPDX-License-Identifier: GPL-2.0-only

config VENDOR_HEWLETT_PACKARD
	bool "Hewlett-Packard"


if VENDOR_HEWLETT_PACKARD

source "src/mainboard/hewlett_packard/probook_4530s/Kconfig.name"

endif
```

## src/mainboard/hewlett_packard/probook_4530s/Kconfig
```kconfig
## SPDX-License-Identifier: GPL-2.0-only

if BOARD_HP_PROBOOK_4530S

config BOARD_SPECIFIC_OPTIONS
	def_bool y
	select AZALIA_USE_LEGACY_VERB_TABLE
	select BOARD_ROMSIZE_KB_4096
	select EC_ACPI
	select EC_HP_KBC1126
	select HAVE_ACPI_RESUME
	select HAVE_ACPI_TABLES
	select INTEL_INT15
	select MAINBOARD_HAS_LIBGFXINIT # FIXME: check this
	select NORTHBRIDGE_INTEL_SANDYBRIDGE
	select SERIRQ_CONTINUOUS_MODE
	select SOUTHBRIDGE_INTEL_BD82X6X
	select SYSTEM_TYPE_LAPTOP
	select USE_NATIVE_RAMINIT

config MAINBOARD_DIR
	string
	default "hewlett_packard/probook_4530s"

config MAINBOARD_PART_NUMBER
	string
	default "HP ProBook 4530s"

config VGA_BIOS_ID
	string
	default "8086,0116"

config DRAM_RESET_GATE_GPIO # FIXME: check this
	int
	default 60

config USBDEBUG_HCD_INDEX # FIXME: check this
	int
	default 2
endif
```

## src/mainboard/hewlett_packard/probook_4530s/Kconfig.name
```kconfig
## SPDX-License-Identifier: GPL-2.0-only

config BOARD_HP_PROBOOK_4530S
	bool "ProBook 4530s"
```
